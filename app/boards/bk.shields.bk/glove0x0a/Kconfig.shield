## app/boards/bk.shields.bk/glove0x0a/Kconfig.shield
```kconfig
config SHIELD_GLOVE0X0A
    bool "glove0x0a"
    depends on BOARD_SEEEDUINO_XIAO_BLE
```

## app/boards/shields/glove0x0a/Kconfig.defconfig
```kconfig
# Copyright (c) 2022 The ZMK Contributors
# SPDX-License-Identifier: MIT

if SHIELD_GLOVE0X0A

config ZMK_KEYBOARD_NAME
    default "glove0x0a"

endif
```

## app/drivers/sensor/Kconfig
```kconfig
# SPDX-License-Identifier: MIT

rsource "battery/Kconfig"
rsource "ec11/Kconfig"
rsource "trackball_pim447/Kconfig"
rsource "az1uball/Kconfig"
```

## app/dts/bindings/behaviors/behavior-sensor-reverse-if-ctrl.yaml
```yaml
title: Sensor Reverse If Ctrl Behavior
description: |
  Reverses scroll direction when Ctrl is active. Used for rotary encoder sensor-bindings.
compatible: "zmk,behavior-sensor-reverse-if-ctrl"

properties:
  label:
    type: string
    required: true
    description: Human-readable label for the behavior.

  direction:
    type: int
    required: true
    description: |
      Scroll direction this node represents.
      Use 1 for normal (e.g. CW = scroll up), -1 for reversed (e.g. CCW = scroll down).

  bindings:
    type: phandle
    required: false
    description: |
      Dummy binding required for Devicetree validation.
      Use <&none> if behavior is handled entirely in C code.

sensor-binding-cells: []
```

## app/dts/bindings/behaviors/zmk,behavior-sensor-reverse-if-ctrl.yaml
```yaml
# Copyright (c) 2025 tさん
# SPDX-License-Identifier: MIT

compatible: "zmk_behavior_sensor_reverse_if_ctrl"

description: >
  Sensor behavior that scrolls based on sensor input and reverses direction when Ctrl is held.

properties: {}
```

## app/dts/bindings/behaviors/zmk,behavior-toggle-action.yaml
```yaml
description: Toggle between two behaviors on each key press

compatible: "zmk,behavior-toggle-action"
include: base.yaml

properties:
  bindings:
    type: phandle-array
    required: true
  label:
    type: string
```

## app/module/Kconfig
```kconfig
rsource "drivers/Kconfig"
rsource "lib/Kconfig"
source "modules/az1uball/Kconfig"
```

## app/module/drivers/sensor/Kconfig
```kconfig
# Copyright (c) 2020 The ZMK Contributors
# SPDX-License-Identifier: MIT

if SENSOR

rsource "battery/Kconfig"
rsource "ec11/Kconfig"
rsource "max17048/Kconfig"

rsource "encoder_mock/Kconfig"

rsource "trackball_pim447/Kconfig"
rsource "az1uball/Kconfig"

endif # SENSOR
```

## app/module/dts/bindings/sensor/zmk,analog-input.yaml
```yaml
description: ZMK Analog Input Sensor

compatible: "zmk,analog_input"

properties:
  io-channels:
    required: true
    type: phandle-array
    description: ADC channel to read
```

## app/module/dts/bindings/sensor/zmk,az1uball.yaml
```yaml
# SPDX-License-Identifier: MIT

description: Driver for az1uball I2C trackball

compatible: "zmk,az1uball"

properties:
  label:
    type: string
    required: true
    description: Human-readable name for the device

  reg:
    type: int
    required: true
    description: I2C address of the az1uball device

  default_mode:
    type: string
    required: false
    description: Default mode ("mouse" or "scroll") at startup

  sensitivity:
    type: string
    required: false
    description: Sensitivity multiplier ("1x", "2x", "4x")
```
